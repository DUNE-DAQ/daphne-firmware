/ {
	/*
	 * Board-owned network defaults belong in the platform software layer, not
	 * in PL RTL.
	 *
	 * This file is intentionally conservative. It shows where KR260/DAPHNE
	 * network identity will be owned once the repo controls the full DT build.
	 *
	 * Replace the placeholder MAC with board-inventory-driven values or a
	 * reproducible derivation rule before enabling it for production.
	 */

	aliases {
		ethernet_daphne_sgmii = &gem0;
	};
};

&gem0 {
	/*
	 * DAPHNE uses GEM0 over the PS GT SGMII path with a fixed-link. Keep that
	 * contract explicit here so Linux does not depend on the generated external
	 * PHY defaults from the base KR260 tree.
	 */
	is-internal-pcspma;
	phy-mode = "sgmii";
	local-mac-address = [02 00 00 00 00 20];
	mac-address = [02 00 00 00 00 20];
	status = "okay";

	fixed-link {
		speed = <1000>;
		full-duplex;
	};
};
